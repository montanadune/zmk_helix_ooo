## boards/shields/helix_right/Kconfig.defconfig
```kconfig
if SHIELD_HELIX_RIGHT

config ZMK_KEYBOARD_NAME
    default "Helix Right"

config ZMK_STUDIO
    default y

endif
```

## boards/shields/helix_right_solo/Kconfig.defconfig
```kconfig
if SHIELD_HELIX_RIGHT_SOLO

config ZMK_KEYBOARD_NAME
    default "Helix Right"

config ZMK_STUDIO
    default y

endif
```

## boards/shields/helix_right_solo/Kconfig.shield
```kconfig
config SHIELD_HELIX_RIGHT_SOLO
    def_bool $(shields_list_contains,helix_right_solo)
```

## config/west.yml
```yaml
manifest:
  remotes:
    - name: zmkfirmware
      url-base: https://github.com
    - name: cormoran
      url-base: https://github.com
  projects:
    - name: zmk
      remote: zmkfirmware
      revision: v0.3
      import: app/west.yml
    - name: zmk-module-ble-management
      remote: cormoran
      revision: zmk-v0.3.0.0
  self:
    path: config
```
